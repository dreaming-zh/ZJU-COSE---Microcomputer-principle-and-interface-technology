
/*---------------------------------------------------------------------*/
/* --- STC MCU Limited ------------------------------------------------*/
/* --- STC 1T Series MCU Demo Programme -------------------------------*/
/* --- Mobile: (86)13922805190 ----------------------------------------*/
/* --- Fax: 86-0513-55012956,55012947,55012969 -----------------------*/
/* --- Tel: 86-0513-55012928,55012929,55012966 ------------------------*/
/* --- Web: www.STCMCU.com --------------------------------------------*/
/* --- Web: www.GXWMCU.com --------------------------------------------*/
/* --- QQ:  800003751 -------------------------------------------------*/
/* 如果要在程序中使用此代码,请在程序中注明使用了STC的资料及程序        */
/*---------------------------------------------------------------------*/
/*************  本程序功能说明  **************
左边4位数码管显示第9通道片内BGV的基准电压读数, 
右边4位数码管显示NTC温度值, 分辨率0.1度.
NTC使用1%精度的MF52 B：3950，10K@25度C.
测温度时, 为了通用, 使用12位的AD，测温度的ADC3进行4次ADC连续采样 
使用对分查找表格来计算, 小数点后一位数是用线性插补来计算的.
******************************************/
#include <stc15.h>
#include <intrins.h>
#include "gdef.h"
#include "adc.h"

/********************** ADC初始化 ************************/
void ADC_Init()	 //CLK_DIV的ADRJ默认为0
{	
    ADC_CONTR = 0xE0;   //90T, ADC power on
	P1ASF = 0;
//	delay();  		  	//1ms以内电源就能稳定
}	  

/*******************查询法读一次ADC结果*******************/
u16 Get_ADC10bitResult(u8 channel)  //channel = 0~8,8为内部BGV
{
	ADC_RES = 0;
    ADC_RESL = 0;

    ADC_CONTR = (ADC_CONTR & 0xe0) | 0x08 | (channel&7);    //start the ADC

    while((ADC_CONTR & 0x10) == 0)  ;   //wait for ADC finish
    ADC_CONTR &= ~0x10;     		//清除ADC结束标志
    return  (((u16)ADC_RES << 2) | (ADC_RESL & 3));	 	
}


//  MF52E 10K at 25, B = 3950, ADC = 12 bits
u16 code temp_table[]={
        140,    //;-40  0
        149,    //;-39  1
        159,    //;-38  2
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        3938,   //;119  159
        3942    //;120  160
};

/********************  计算温度 ***********************************************/
// 计算结果: 0对应-40.0度, 400对应0度, 650对应25.0度, 最大1600对应120.0度. 
// 为了通用, ADC输入为12bit的ADC值.
/**********************************************/  
#define     D_SCALE     10      //1位小数，为了避免出现小数，结果放大倍数
u16 get_temperature(u16 adc)
{
    u16 code *p;
    u8  j,k,min,max;
    
    adc = 4096 - adc;   //Rt接地
    p = temp_table;
    if(adc < p[0]||adc > p[160]) //超出量程   
		return (0xffff);
    
    min = 0;        //-40度
    max = 160;      //120度

    for(j=0; j<8; j++)  //对分查表，2^8可查256项>160
    {
        k = (min + max) / 2;
        if(adc < p[k]) max = k;
        else           min = k;
    }
    if(adc == p[min]) return min * D_SCALE;
//    else if(adc == p[max]) return max * D_SCALE;
    else // min < temp < max   max=min+1  
		return min* D_SCALE+(adc - p[min]) * D_SCALE / (p[max] - p[min]);
}

